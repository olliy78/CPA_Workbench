## configmenu/bc_a5120/Kconfig.system
```kconfig
# Kconfig für die Konfiguration des CP/A Betriebssystemkernels für BC A5120

mainmenu "CP/A System Konfiguration - Konfiguration des System Kernels @OS.COM [? für Hilfe]"
config HINT_INFO
    bool "=== Hinweise zur Konfiguration [? für Hilfe] ==="
    help
        CP/A Einstellungen können vor Allem in der bios.mac aber auch in
        anderen Dateien vorgenommen werden. Hier können nur die wichtigsten
        Dinge eingestellt werden. Nach dem Speichern und Beenden werden die
        Änderungen in die bios.mac übernommen. Nachdem die gewünschte
        Änderungen vorgenommen wurden, das Menü mit [Q] oder [Esc] beenden
        und unbedingt Speichern.
    default n

menu "Hardwarevariante"
choice
    prompt "Geraeteversion"
    default SYSTEM_DEV_OEM
    config SYSTEM_DEV_OEM
        bool "OEM-Geraet (oem=0)"
        help
            source=bios.mac dev=oem
    config SYSTEM_DEV_CPD
        bool "Hardware-Variante CP/D (cpd=1)"
        help
            source=bios.mac dev=cpd
    config SYSTEM_DEV_K8915
        bool "Hardware-Variante K8915 (k8915=2)"
        help
            source=bios.mac dev=k8915
endchoice

choice
    prompt "Prozessor-Takt (MHz)"
    default SYSTEM_CPUCLK_25
    config SYSTEM_CPUCLK_25
        bool "2,5 MHz (cpuclk=25)"
        help
            source=bios.mac cpuclk=25
    config SYSTEM_CPUCLK_40
        bool "4,0 MHz (cpuclk=40)"
        help
            source=bios.mac cpuclk=40
endchoice

choice
    prompt "CPU-Typ"
    default SYSTEM_CPU_K2526
    config SYSTEM_CPU_K2521
        bool "K2521 (1)"
        help
            source=bios.mac cpu=k2521
    config SYSTEM_CPU_K2526
        bool "K2526 (6)"
        help
            source=bios.mac cpu=k2526
    config SYSTEM_CPU_C1715
        bool "C1715 (7)"
        help
            source=bios.mac cpu=c1715
endchoice

choice
    prompt "Floppy-Karte"
    default SYSTEM_FDC_K5122
    config SYSTEM_FDC_K5120
        bool "K5120 (0)"
        help
            source=bios.mac fdc=k5120
    config SYSTEM_FDC_K5122
        bool "K5122 (1)"
        help
            source=bios.mac fdc=k5122
    config SYSTEM_FDC_K5126
        bool "K5126 (6)"
        help
            source=bios.mac fdc=k5126
    config SYSTEM_FDC_F1715
        bool "PC1715 (7)"
        help
            source=bios.mac fdc=f1715
    config SYSTEM_FDC_FDC3
        bool "FDC3 (11)"
        help
            source=bios.mac fdc=fdc3
endchoice

choice
    prompt "Bildschirm-Karte"
    default SYSTEM_CRT_K7024
    config SYSTEM_CRT_K7024
        bool "K7024 (0) Bildschirm-Karte mit Kursor durch Bit 7"
        help
            source=bios.mac crt=k7024
    config SYSTEM_CRT_DSY5
        bool "DSY5 (1) Bildschirm-Karte mit Invers durch Bit 7 (z.B. VDE Buch)"
        help
            source=bios.mac crt=dsy5
    config SYSTEM_CRT_B1715
        bool "PC 1715 (7)"
        help
            source=bios.mac crt=b1715
endchoice

choice
    prompt "RAM-Größe (kBytes)"
    default SYSTEM_RAM_64
    config SYSTEM_RAM_64
        bool "64 kBytes"
        help
            source=bios.mac ramkb=64
    config SYSTEM_RAM_32
        bool "32 kBytes"
        help
            source=bios.mac ramkb=32
endchoice

config SYSTEM_MEMORY_PROTECTION
    bool "Speicherschutz aktivieren"
    help
        source=bios.mac mprot=1
        Aktiviert den BIOS-Speicherschutz. Bei aktivem Schutz werden
        Routinen eingebunden, die versehentliche oder unerwünschte
        Speicherzugriffe verhindern können. Siehe cpa_doc.txt für Details.
    default n

config SYSTEM_STOP_FUNCTION
    bool "STOP-Funktion aktivieren"
    help
        source=bios.mac stpvar=1
        Aktiviert die STOP-Funktion im BIOS. Damit können spezielle
        Tastenkombinationen genutzt werden, um Programme oder Drucker
        gezielt zu stoppen. Siehe cpa_doc.txt für Details.
    default n

endmenu


# Menü für RAM Disk Optionen

menu "RAM Disk (RAM-Floppy) Optionen"
config HINT_BUILD
    bool "=== Hinweise zum Build-Ziel [? für Hilfe] ==="
    help
        Hier können Sie konfigurieren, ob beim Systemstart eine RAM-Floppy (RAM Disk 'M:') eingerichtet werden soll.
        Es stehen verschiedene Hardware-Erweiterungen zur Verfügung, die als RAM-Floppy genutzt werden können.
        Die Auswahl wirkt sich auf die Generierung der bios.mac aus.

        Technische Hinweise (aus bios.mac):
        - OSS 48k: Falls eine 48k Speichererweiterung (OSS 062-8471) vorhanden ist, wird beim Kaltstart 
          eine RAM-Floppy "M:" für diesen Bereich angelegt. Bei "oss=0" erfolgt kein Test auf eine evtl. 
          vorhandene OSS-Karte.
        - EM256: Wenn eine 16-Bit-Erweiterungskarte mit 256k-Speicher EM256 installiert ist, kann dieser 
          Speicher als RAM-Floppy 'M:' genutzt werden. Bei "em256" ungleich Null wird das Vorhandensein 
          einer Erweiterungskarte getestet. Bei vorhandener EM256 wird beim Kaltstart die RAM-Floppy 
          eingerichtet.
        - MKD256: Die RAM-Floppy mkd256 kann als Laufwerk 'M:' angesprochen werden. Bei "mkd256" ungleich 
          Null wird das Vorhandensein einer entsprechenden Karte getestet. Ist diese vorhanden, wird 
          sie beim Kaltstart initialisiert.
        - RAF: Wenn mindestens eine RAF-Karte des ZWG der AdW vorhanden ist (beliebig bestückt, max. 
          2M Byte pro Karte, max. 4 Karten), so kann bzw. können diese als RAM-Floppy 'M:' benutzt 
          werden (über "SWAP A: M:" bei Bedarf auch als LW A:). Bei "raf" ungleich Null wird das 
          Vorhandensein von RAF-Karten getestet. Bei vorhandener(n) Karte(n) wird beim erstmaligen 
          Kaltstart nach dem Einschalten des Stromes die RAM-Floppy eingerichtet, bei RESET bleibt 
          ihr Inhalt erhalten.
        - NANOS-RAF: Wenn mindestens eine NANOS-256k-DRAM-Karte vorhanden ist (beliebig bestückt, max. 
          256k Byte pro Karte, max. 4 Karten), so kann bzw. können diese als RAM-Floppy 'M:' benutzt 
          werden (über "SWAP A: M:" bei Bedarf auch als LW A:). Bei "rna" ungleich Null wird das 
          Vorhandensein von NANOS-RAF-Karten getestet. Bei vorhandener(n) Karte(n) wird beim erstmaligen 
          Kaltstart nach dem Einschalten des Stromes die RAM-Floppy eingerichtet, bei RESET bleibt 
          ihr Inhalt erhalten.

        Allgemeiner Hinweis: Die RAM-Floppy ist ein schneller, flüchtiger Massenspeicher und wird beim Kaltstart initialisiert. Daten gehen beim Ausschalten verloren!
    default n

choice
    prompt "RAM Disk Typ (RAM-Floppy)"
    default SYSTEM_RAMDISK_NONE
    help
        Wählen Sie die gewünschte RAM-Floppy-Option:
        - Keine: Es wird keine RAM-Floppy eingerichtet.
        - OSS 48k: RAM-Floppy mit OSS 062-8471 Speichererweiterung (48k)
        - EM256: RAM-Floppy mit 16-Bit-Erweiterungskarte EM256 (256k)
        - MKD256: RAM-Floppy mit MKD256-Karte
        - RAF: RAM-Floppy mit RAF-Karte (max. 4 Karten, je 2MB)
        - NANOS-RAF: RAM-Floppy mit NANOS-256k-DRAM-Karte (max. 4 Karten)
    config SYSTEM_RAMDISK_NONE
        bool "Keine RAM-Floppy (oss=0, em256=0, mkd256=0, raf=0, rna=0)"
        help
            source=bios.mac oss=0 em256=0 mkd256=0 raf=0 rna=0
            Es wird keine RAM-Floppy eingerichtet.
    config SYSTEM_RAMDISK_OSS
        bool "OSS 48k Speichererweiterung (oss=1)"
        help
            source=bios.mac oss=1 em256=0 mkd256=0 raf=0 rna=0
            Nutzt eine OSS 062-8471 Speichererweiterung (48k) als RAM-Floppy 'M:'.
    config SYSTEM_RAMDISK_EM256
        bool "EM256 16-Bit-Erweiterung (em256=1)"
        help
            source=bios.mac oss=0 em256=1 mkd256=0 raf=0 rna=0
            Nutzt eine 16-Bit-Erweiterungskarte EM256 (256k) als RAM-Floppy 'M:'.
    config SYSTEM_RAMDISK_MKD256
        bool "MKD256 RAM-Floppy (mkd256=1)"
        help
            source=bios.mac oss=0 em256=0 mkd256=1 raf=0 rna=0
            Nutzt eine MKD256-Karte als RAM-Floppy 'M:'.
    config SYSTEM_RAMDISK_RAF
        bool "RAF-Karte (raf=1)"
        help
            source=bios.mac oss=0 em256=0 mkd256=0 raf=1 rna=0
            Nutzt mindestens eine RAF-Karte (max. 4, je 2MB) als RAM-Floppy 'M:'.
    config SYSTEM_RAMDISK_NANOS
        bool "NANOS-256k-DRAM-Karte (rna=1)"
        help
            source=bios.mac oss=0 em256=0 mkd256=0 raf=0 rna=1
            Nutzt mindestens eine NANOS-256k-DRAM-Karte (max. 4) als RAM-Floppy 'M:'.
endchoice

endmenu


menu "Diskettenlaufwerke"
choice
    prompt "Laufwerk A Typ"
    default SYSTEM_DRIVE_A_11580
    config SYSTEM_DRIVE_A_10540
        bool "DD, SS, 5', 40 Tracks (K5600.10)"
        help
            source=bios.mac diskA=10540
    config SYSTEM_DRIVE_A_10580
        bool "DD, SS, 5', 80 Tracks (K5600.20)"
        help
            source=bios.mac diskA=10580
    config SYSTEM_DRIVE_A_11580
        bool "DD, DS, 5', 80 Tracks (K5601 !!!)"
        help
            source=bios.mac diskA=11580
    config SYSTEM_DRIVE_A_00877
        bool "SD, SS, 8', 77 Tracks (MF3200)"
        help
            source=bios.mac diskA=00877
    config SYSTEM_DRIVE_A_10877
        bool "DD, SS, 8', 77 Tracks (K5602.10, MF6400)"
        help
            source=bios.mac diskA=10877
    config SYSTEM_DRIVE_A_0
        bool "Nicht vorhanden"
        help
            source=bios.mac diskA=0
endchoice

choice
    prompt "Laufwerk B Typ"
    default SYSTEM_DRIVE_B_11580
    config SYSTEM_DRIVE_B_10540
        bool "DD, SS, 5', 40 Tracks (K5600.10)"
        help
            source=bios.mac diskB=10540
    config SYSTEM_DRIVE_B_10580
        bool "DD, SS, 5', 80 Tracks (K5600.20)"
        help
            source=bios.mac diskB=10580
    config SYSTEM_DRIVE_B_11580
        bool "DD, DS, 5', 80 Tracks (K5601 !!!)"
        help
            source=bios.mac diskB=11580
    config SYSTEM_DRIVE_B_00877
        bool "SD, SS, 8', 77 Tracks (MF3200)"
        help
            source=bios.mac diskB=00877
    config SYSTEM_DRIVE_B_10877
        bool "DD, SS, 8', 77 Tracks (K5602.10, MF6400)"
        help
            source=bios.mac diskB=10877
    config SYSTEM_DRIVE_B_0
        bool "Nicht vorhanden"
        help
            source=bios.mac diskB=0
endchoice

choice
    prompt "Laufwerk C Typ"
    default SYSTEM_DRIVE_C_0
    config SYSTEM_DRIVE_C_10540
        bool "DD, SS, 5', 40 Tracks (K5600.10)"
        help
            source=bios.mac diskC=10540
    config SYSTEM_DRIVE_C_10580
        bool "DD, SS, 5', 80 Tracks (K5600.20)"
        help
            source=bios.mac diskC=10580
    config SYSTEM_DRIVE_C_11580
        bool "DD, DS, 5', 80 Tracks (K5601 !!!)"
        help
            source=bios.mac diskC=11580
    config SYSTEM_DRIVE_C_00877
        bool "SD, SS, 8', 77 Tracks (MF3200)"
        help
            source=bios.mac diskC=00877
    config SYSTEM_DRIVE_C_10877
        bool "DD, SS, 8', 77 Tracks (K5602.10, MF6400)"
        help
            source=bios.mac diskC=10877
    config SYSTEM_DRIVE_C_0
        bool "Nicht vorhanden"
        help
            source=bios.mac diskC=0
endchoice

choice
    prompt "Laufwerk D Typ"
    default SYSTEM_DRIVE_D_0
    config SYSTEM_DRIVE_D_10540
        bool "DD, SS, 5', 40 Tracks (K5600.10)"
        help
            source=bios.mac diskD=10540
    config SYSTEM_DRIVE_D_10580
        bool "DD, SS, 5', 80 Tracks (K5600.20)"
        help
            source=bios.mac diskD=10580
    config SYSTEM_DRIVE_D_11580
        bool "DD, DS, 5', 80 Tracks (K5601 !!!)"
        help
            source=bios.mac diskD=11580
    config SYSTEM_DRIVE_D_00877
        bool "SD, SS, 8', 77 Tracks (MF3200)"
        help
            source=bios.mac diskD=00877
    config SYSTEM_DRIVE_D_10877
        bool "DD, SS, 8', 77 Tracks (K5602.10, MF6400)"
        help
            source=bios.mac diskD=10877
    config SYSTEM_DRIVE_D_0
        bool "Nicht vorhanden"
        help
            source=bios.mac diskD=0
endchoice

config SYSTEM_HARDDISK_SUPPORT
    bool "HardDisk-Unterstützung aktivieren"
    help
        source=bios.mac hdsk=1
        Aktiviert die Unterstützung für XT-kompatible Festplatten im BIOS.
        Ein Spezialadapter ermöglicht die Nutzung einer HardDisk am 8-bit-Bus.
        Weitere Informationen siehe cpa_doc.txt und BIOS-Dokumentation.
    default n

endmenu

menu "Systemstart Einstellungen"

config SYSTEM_AUTOEXEC_STR
    string "Automatische Komando ausführung (autoexec)"
    help
        source=bios.mac kltbef=string
        Es besteht die Moeglichkeit, beim Kaltstart des Systems automatisch
        ein Kommando auszufuehren z.B. 'DIR *.COM'. Dies kann auch ueber SUBMIT eine Kommando-
        folge sein.

choice
    prompt "Ausführen bei:"
    default SYSTEM_AUTOEXEC_COLD
    config SYSTEM_AUTOEXEC_COLD
        bool "nur bei Kaltstart / Einschalten"
        help
            source=bios.mac cldcmx=0
            Befehl wird nur beim Einschalten also Kaltstart des Systems ausgeführt
    config SYSTEM_AUTOEXEC_RESET
        bool "Kaltstart und Reset"
        help
            source=bios.mac cldcmx=1
            Befehl beim Einschalten also Kaltstart des Systems und nach einem Reset ausgeführt
endchoice
endmenu

menu "Systemfunktionen"
config SYSTEM_STATUSZEILE_ON
        bool "Statuszeile"
        help
            source=bios.mac cpastz=1
            Statuszeile anzeigen (nur für PC1715)
choice
    prompt "Format der Statuszeile"
    config SYSTEM_STATUSZEILE_05
            bool "Statuszeile invers, normale Helligkeit"
            help
                source=bios.mac stzfrm=05h
                invers, normale Helligkeit
    config SYSTEM_STATUSZEILE_07
            bool "Statuszeile invers, andere  Helligkeit"
            help
                source=bios.mac stzfrm=07h
                invers, andere  Helligkeit
    config SYSTEM_STATUSZEILE_04
            bool "Statuszeile nicht invers, normale Helligkeit"
            help
                source=bios.mac stzfrm=04h
                nicht invers, normale Helligkeit
    config SYSTEM_STATUSZEILE_06
            bool "Statuszeile nicht invers, andere  Helligkeit"
            help
                source=bios.mac stzfrm=06h
                nicht invers, andere  Helligkeit
endchoice
config SYSTEM_FORMATERKENNUNG
        bool "autom. Formaterkennung"
        default y
        help
            source=bios.mac format=1
            Es wird eine automatische Formaterkennung fuer gaengige CP/M-
            Diskettenformate einschliesslich der SCP-Hausformate von CP/A
            unterstuetzt. Dies kann unterdrueckt werden, wenn nur mit
            festen Formaten gearbeitet wird (und eine extra CP/A-Variante
            fuer den Datenaustausch mit Formaterkennung existiert). In
            diesem Fall haben die Disketten das Standard-CP/A-Format ent-
            sprechend dem vorgegebenen LW-Typ.
config SYSTEM_FORMATBOOT
        bool "Format mit Systemspur als Standardformat"
        default y
        help
            source=bios.mac @fsys=1
            Nur relevant wenn automatische Formaterkennung deaktiviert
            wenn aktiv, wird immer das Standardformt des Lauwerks mit Systemspur verwendet
config SYSTEM_MONITOR
        bool "Verwendung Bios-Monitor"
        default n
        help
            source=bios.mac monitor=1
            Der  BIOS-Monitor  stellt - seine Generierung vorausgesetzt  -  
            einen  Satz von residenten Funktionen bereit,  die somit  ohne  
            Veraenderung  der Speicherplatzbelegung  staendig,  d.h.  auch  
            waehrend der Arbeit eines Nutzerprogramms zur Verfuegung  ste- 
            hen. Die Benutzung des Bios-Motitors ist in cpa_doc.txt beschrieben

config SYSTEM_UMLAUT_ENCODING
    bool "Umlautumcodierung aktivieren"
    help
        source=bios.mac umlaut=1
        Aktiviert die Umcodierung für deutsche Umlaute im Zeichensatz.
        Umlaute werden auf dem Bildschirm korrekt dargestellt, sofern
        ein passender Zeichengenerator vorhanden ist. Siehe cpa_doc.txt
        und BIOS-Dokumentation für Details.
    default n

endmenu
menu "Serielle Schnittstellen und Drucker"

config SYSTEM_SERIAL_IOBTTY
    string "iobtty (Drucker 1: Schnittstellen-Konfiguration)"
    help
        source=bios.mac iobtty=hexstring
        Konfiguriert die serielle Schnittstelle für Drucker 1.
        Format: PSCBT
        P: Parität (0=keine, 1=ungerade, 2=gerade)
        S: Stopbits (1=1, 2=2, 3=1.5)
        C: Datenbits (5..8)
        B: Baudrate (1=9600,2=4800,3=2400,4=1200,5=600,6=300,7=150,8=100,9=75)
        T: Treiber/Protokoll (0=DC1/DC3, 1=DTR+DSR, 2=Strombauch, 3=DTR+CTS, 5=PIO, ...)
        Beispiel: 01811 (ohne Parität, 1 Stopbit, 8 Bit, 9600 Bd, DTR)
        Beispiel: 11710 (ungerade Parität, 1 Stopbit, 7 Bit, 9600 Bd, DC1/3)
        Siehe bios.mac Zeilen 458-489 für Details und weitere Beispiele.

config SYSTEM_SERIAL_TTYDAT
    string "ttydat (Daten-Adresse Drucker 1)"
    help
        source=bios.mac ttydat=hexstring
        Datenadresse für Drucker 1. Mögliche Karten und Adressen:
        K8025: 5e (IFSS), 5c, 52
        K6028/K8025: 50 (V.24)
        K6022: 54, 50
        Siehe bios.mac Zeilen 432-449 für weitere Karten und Bemerkungen.

config SYSTEM_SERIAL_TTYSTA
    string "ttysta (Status-Adresse Drucker 1)"
    help
        source=bios.mac ttysta=hexstring
        Statusadresse für Drucker 1. Mögliche Karten und Adressen:
        K8025: 5f, 5d, 53
        K6028/K8025: 51, 53
        K6022: 56, 51
        Siehe bios.mac Zeilen 432-449 für weitere Karten und Bemerkungen.

config SYSTEM_SERIAL_TTYCTS
    string "ttycts (CTS-Adresse Drucker 1)"
    help
        source=bios.mac ttycts=hexstring
        CTS-Adresse für Drucker 1. Mögliche Karten und Adressen:
        K8025: 58, 0c
        K6028/K8025: 0c
        K6022: 58
        Siehe bios.mac Zeilen 432-449 für weitere Karten und Bemerkungen.

config SYSTEM_SERIAL_TTYCTR
    string "ttyctr (CTR-Adresse Drucker 1)"
    help
        source=bios.mac ttyctr=hexstring
        CTR-Adresse für Drucker 1. Mögliche Karten und Adressen:
        K8025: 58, 0c
        K6028/K8025: 0c
        K6022: 58
        Siehe bios.mac Zeilen 432-449 für weitere Karten und Bemerkungen.

# Zweiter Drucker
config SYSTEM_SERIAL_IOBLPT
    string "ioblpt (Drucker 2: Schnittstellen-Konfiguration)"
    help
        source=bios.mac ioblpt=hexstring
        Konfiguriert die serielle Schnittstelle für Drucker 2.
        Format und Bedeutung wie bei iobtty (siehe oben).

config SYSTEM_SERIAL_LPTDAT
    string "lptdat (Daten-Adresse Drucker 2)"
    help
        source=bios.mac lptdat=hexstring
        Datenadresse für Drucker 2. Mögliche Karten und Adressen siehe ttydat.

config SYSTEM_SERIAL_LPTSTA
    string "lptsta (Status-Adresse Drucker 2)"
    help
        source=bios.mac lptsta=hexstring
        Statusadresse für Drucker 2. Mögliche Karten und Adressen siehe ttysta.

config SYSTEM_SERIAL_LPTCTS
    string "lptcts (CTS-Adresse Drucker 2)"
    help
        source=bios.mac lptcts=hexstring
        CTS-Adresse für Drucker 2. Mögliche Karten und Adressen siehe ttycts.

config SYSTEM_SERIAL_LPTCTR
    string "lptctr (CTR-Adresse Drucker 2)"
    help
        source=bios.mac lptctr=hexstring
        CTR-Adresse für Drucker 2. Mögliche Karten und Adressen siehe ttyctr.

# Koppelschnittstelle
config SYSTEM_SERIAL_IOBUC1
    string "iobuc1 (Koppelschnittstelle: Schnittstellen-Konfiguration)"
    help
        source=bios.mac iobuc1=hexstring
        Konfiguriert die serielle Schnittstelle für die Koppelschnittstelle (UC1).
        Format: PSCBT
        P: Parität (0=keine, 1=ungerade, 2=gerade)
        S: Stopbits (1=1, 2=2, 3=1.5)
        C: Datenbits (5..8)
        B: Baudrate (1=9600,2=4800,3=2400,4=1200,5=600,6=300,7=150,8=100,9=75)
        T: Treiber/Protokoll (0=DC1/DC3, 1=DTR+DSR, 2=Strombauch, 3=DTR+CTS, 5=PIO, ...)
        Beispiel: 01811 (ohne Parität, 1 Stopbit, 8 Bit, 9600 Bd, DTR)
        Beispiel: 11710 (ungerade Parität, 1 Stopbit, 7 Bit, 9600 Bd, DC1/3)
        Siehe bios.mac Zeilen 458-489 für Details und weitere Beispiele.

config SYSTEM_SERIAL_UC1DAT
    string "uc1dat (Daten-Adresse UC1)"
    help
        source=bios.mac uc1dat=hexstring
        Datenadresse für UC1. Beispiele für Karten und Adressen:
        K8025: 5e (IFSS), 5c, 52
        K6028/K8025: 50 (V.24)
        K6022: 54, 50
        Weitere Adressen siehe bios.mac Zeilen 432-449.

config SYSTEM_SERIAL_UC1STA
    string "uc1sta (Status-Adresse UC1)"
    help
        source=bios.mac uc1sta=hexstring
        Statusadresse für UC1. Beispiele für Karten und Adressen:
        K8025: 5f, 5d, 53
        K6028/K8025: 51, 53
        K6022: 56, 51
        Weitere Adressen siehe bios.mac Zeilen 432-449.

config SYSTEM_SERIAL_UC1CTS
    string "uc1cts (CTS-Adresse UC1)"
    help
        source=bios.mac uc1cts=hexstring
        CTS-Adresse für UC1. Beispiele für Karten und Adressen:
        K8025: 58, 0c
        K6028/K8025: 0c
        K6022: 58
        Weitere Adressen siehe bios.mac Zeilen 432-449.

config SYSTEM_SERIAL_UC1CTR
    string "uc1ctr (CTR-Adresse UC1)"
    help
        source=bios.mac uc1ctr=hexstring
        CTR-Adresse für UC1. Beispiele für Karten und Adressen:
        K8025: 58, 0c
        K6028/K8025: 0c
        K6022: 58
        Weitere Adressen siehe bios.mac Zeilen 432-449.

config SYSTEM_SERIAL_UC1BFL
    string "uc1bfl (UC1-Pufferlänge)"
    help
        source=bios.mac uc1bfl=hexstring
        Länge des UC1-Puffers. Muss z.B. 2k Bildschirmrollen abfangen können.
        Empfohlen: >=20 bei 9600 Baud.
        Beispiel: 20
        Siehe bios.mac Kommentar zu uc1bfl.


endmenu
```
