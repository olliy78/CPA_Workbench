## configmenu/Kconfig.build
```kconfig
# Kconfig für Build-Ausgabeformat
mainmenu "CP/A System Konfiguration - Konfiguration Build-Ausgabeformat [? für Hilfe]"
config HINT_BUILD
    bool "=== Hinweise zum Build-Ziel [? für Hilfe] ==="
    help
        Hier wird festgelegt, welches Build-Ziel nach Abschluss der Konfiguration ausgeführt werden soll.
        Standardmäßig wird kein Build durchgeführt. Wähle genau ein Build-Ziel aus.
        Die Auswahl kann jederzeit geändert werden.
    default n

choice
    prompt "Build-Ziel auswählen"
    default BUILD_OS
    help
        Wähle genau ein Build-Ziel aus.

config BUILD_OS
    bool "Nur @OS.COM bauen"
    help
        Erstellt nur das Betriebssystem (@OS.COM) im build/-Verzeichnis. Kein Diskettenimage, keine Ausgabe auf Diskette.

config BUILD_DISKIMAGE
    bool "Diskettenimage als *.img erzeugen"
    help
        Erstellt nach dem Build ein Diskettenimage (build/cpadisk.img) mit dem neuen System.

config BUILD_DISKIMAGEHFE
    bool "Diskettenimage als *.hfe erzeugen"
    help
        Erstellt nach dem Build ein Diskettenimage (build/cpadisk.hfe) mit dem neuen System.

config BUILD_DISKIMAGESCP
    bool "Diskettenimage als *.scp erzeugen"
    help
        Erstellt nach dem Build ein Diskettenimage (build/cpadisk.scp) mit dem neuen System.

config BUILD_WRITEIMAGE
    bool "Diskettenimage auf Laufwerk schreiben"
    help
        Schreibt nach dem Build das Diskettenimage direkt auf ein physikalisches Laufwerk (z.B. mit gw).

endchoice

config BUILD_CLEAN
    bool "Aufräumen (clean) vor dem Build durchführen"
    help
        Führt vor dem eigentlichen Build automatisch ein 'make clean' aus und entfernt alle temporären und erzeugten Dateien.
        Dies ist nützlich, um das Build-Verzeichnis komplett zurückzusetzen, bevor das gewünschte Build-Target gebaut wird.
    default y

choice
    prompt "Auswahl Diskettentyp"
    default DISKTYPE_780K
    help
        Wähle den Diskettentyp für das erzeugte Image. Es muss genau eine Option gewählt werden.

config DISKTYPE_780K
    bool "780 kByte mit 3 System-Spuren und A5120 CP/A loader"
    help
        Format für A5120: 780 kByte, 3 Systemspuren, CP/A Bootloader.

config DISKTYPE_800K
    bool "800 kByte für PC 1715"
    help
        Format für PC 1715: 800 kByte, geeignet für PC 1715 Hardware.

endchoice
```

## configmenu/Kconfig.system
```kconfig
# Kconfig für Systemtyp-Auswahl
mainmenu "CP/A System Konfiguration - Auswahl der zu verwendenden Variante [? für Hilfe]"
config HINT_INFO
    bool "=== Hinweise zur Konfiguration [? für Hilfe] ==="
    help
        Es können mehrere Quelltextversionen / Varianten hinterlegt sein. Hier wird ausgewählt, 
        welche verwendet werden soll. In README.md ist beschrieben, wie und wo man neue Varianten anlegen kann.
        Nachdem die gewünschte Variante ausgewählt wurde, das Menü mit [Q] oder [Esc] beenden und unbedingt Speichern.
    default n
menu "Systemtyp auswählen"
choice
    prompt "Systemtyp"
    default SYSTEM_BC_A5120
    help
        Aktuell sind folgende Systemvarianten hinterlegt:
        A5120 (BC) - Angeblich vom 25.09.89 - Läuft auf dem BC Vermutlich auch auf PC1715, CP/D und K8915
        PC1715 (PC) - Angeblich vom 24.05.88 - Titel: BIOS CP/A fuer PC1715
        PC1715 (870330) - Angeblich vom 30.03.87 
config SYSTEM_BC_A5120
    bool "A5120 (BC)"
    help
        A5120 (BC) - Angeblich vom 25.09.89 - Läuft auf dem BC Vermutlich auch auf PC1715, CP/D und K8915
config SYSTEM_PC_1715
    bool "PC1715 (PC)"
    help
        PC1715 (PC) - Angeblich vom 24.05.88 - Titel: BIOS CP/A fuer PC1715
config SYSTEM_PC_1715_870330
    bool "PC1715 (870330)"
    help
        PC1715 (870330) - Angeblich vom 30.03.87 
endchoice

endmenu
```
